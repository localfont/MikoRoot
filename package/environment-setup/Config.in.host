## package/environment-setup/Config.in.host
```kconfig
config BR2_PACKAGE_HOST_ENVIRONMENT_SETUP
	bool "host environment-setup"
	help
	  Install an helper script to setup a build environment
	  based on MikoOS. It's useful when you export an sdk
	  and want to use MikoOS to build an external project.
```
